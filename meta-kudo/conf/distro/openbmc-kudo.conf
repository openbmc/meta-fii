## meta-kudo/conf/distro/openbmc-kudo.conf
```bitbake
require conf/distro/openbmc-phosphor.conf

DISTRO_FEATURES_remove = "avahi"
DISTRO_FEATURES_remove = "slp"

DISTRO = "openbmc-kudo"
```

## meta-kudo/conf/machine/kudo.conf
```bitbake
KMACHINE = "nuvoton"
KERNEL_DEVICETREE = "${KMACHINE}-npcm730-kudo.dtb"

require conf/machine/include/npcm7xx.inc
require conf/machine/include/obmc-bsp-common.inc

FLASH_SIZE = "65536"
FLASH_UBOOT_OFFSET = "0"
FLASH_KERNEL_OFFSET = "2048"
FLASH_ROFS_OFFSET = "7168"
FLASH_RWFS_OFFSET = "62400"

UBOOT_MACHINE = "PolegSVB_config"
UBOOT_DEVICETREE = "nuvoton-npcm730-kudo"
IGPS_MACHINE = "EB"

IMAGE_FSTYPES += " cpio.${INITRAMFS_CTYPE}.u-boot"

SERIAL_CONSOLES = "115200;ttyS0"

BMC_MACHINE_FEATURES += " \
        obmc-phosphor-chassis-mgmt \
        obmc-host-state-mgmt \
        obmc-chassis-state-mgmt \
        obmc-bmc-state-mgmt \
        obmc-host-ipmi \
        "

VIRTUAL-RUNTIME_obmc-fan-control = "phosphor-pid-control"

VIRTUAL-RUNTIME_obmc-host-state-manager = "x86-power-control"
VIRTUAL-RUNTIME_obmc-chassis-state-manager = "x86-power-control"
VIRTUAL-RUNTIME_obmc-discover-system-state = "x86-power-control"

PREFERRED_PROVIDER_virtual/obmc-fan-control = "phosphor-pid-control"
PREFERRED_PROVIDER_virtual/obmc-system-mgmt = "packagegroup-kudo-apps"
PREFERRED_PROVIDER_virtual/obmc-host-ipmi-hw = "phosphor-ipmi-ssif"
PREFERRED_PROVIDER_virtual/obmc-flash-mgmt = "packagegroup-kudo-apps"
PREFERRED_PROVIDER_virtual/obmc-chassis-mgmt = "packagegroup-kudo-apps"

# Inhibit phosphor-fan-presence-mrw-native
PREFERRED_PROVIDER_virtual/phosphor-fan-presence-config_df-mrw = "phosphor-fan-presence-config"

# Remove unneeded binaries from image
IMAGE_FEATURES_remove = "avahi obmc-health-monitor"
```
